## sdkconfig.defaults
```kconfig
# Galena Light Bar — sdkconfig.defaults (ESP32-C3)

# ESP-NOW / WiFi
CONFIG_ESP_WIFI_ESPNOW_MAX_ENCRYPT_NUM=0

# Log level
CONFIG_LOG_DEFAULT_LEVEL_INFO=y

# Flash (chip has 4MB)
CONFIG_ESPTOOLPY_FLASHSIZE_4MB=y
```
